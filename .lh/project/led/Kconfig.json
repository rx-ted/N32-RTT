## libraries/Kconfig
```kconfig
# config N32G4FR
#     bool "N32G4FR"
#     default y

# config USE_STDPERIPH_DRIVER
#     bool "USE STDPERIPH DRIVER"
#     default y

menu "External Libraries"

    config RT_USING_ALGO_LIB
        bool "Using Alogrithm Library"
        default n

    config RT_USING_USB_LIB
        bool "Using USB Library"
        default n

endmenu
```

## rt-thread/Kconfig
```kconfig
config RT_USING_TINY_SIZE
    bool "This function will set the content of memory to specified value"
    default y


source "$RTT_DIR/src/Kconfig"
source "$RTT_DIR/libcpu/Kconfig"
source "$RTT_DIR/components/Kconfig"
# source "$RTT_DIR/examples/utest/testcases/Kconfig"
```

## rt-thread/libcpu/Kconfig
```kconfig
config ARM_CORTEX_M4
    bool "ARM CORTEX M4"
    select ARM_CORTEX_M4
    default y
```
